## linux/layers/meta-flatsat2-bsp/conf/machine/include/flatsat-common.inc
```bitbake
# Common features for FlatSat2 Machines

YAML_DT_BOARD_FLAGS ?= ""
YAML_CONSOLE_DEVICE_CONFIG:pn-device-tree ?= "ps7_uart_1"
YAML_MAIN_MEMORY_CONFIG:pn-device-tree ?= "PS7_DDR_0"
YAML_SERIAL_CONSOLE_STDIN:pn-fsbl-firmware ?= "ps7_uart_1"
YAML_SERIAL_CONSOLE_STDOUT:pn-fsbl-firmware ?= "ps7_uart_1"
YAML_SERIAL_CONSOLE_BAUDRATE ?= "115200"
SERIAL_CONSOLES ?= "115200;ttyPS0"
DT_PADDING_SIZE:pn-device-tree ?= "0x1000"
DTC_FLAGS:pn-device-tree ?= "-@"

LOCAL_XSA_FILE ?= "${FLATSAT_BSP_LAYERDIR}/hw/xsa/flatsat2.xsa"
HDF_EXT ?= "xsa"
HDF_BASE ?= "file://"
HDF_PATH ?= "${LOCAL_XSA_FILE}"
HDF_MACHINE = ""

require conf/machine/zynq-generic.conf

SPL_BINARY ?= "spl/boot.bin"

IMAGE_FSTYPES:remove = "cpio cpio.gz cpio.gz.u-boot"
IMAGE_FSTYPES += "ext4 wic wic.bmap"

KERNEL_IMAGETYPES:remove = "zImage"

MACHINE_FEATURES += "fpga-overlay"

MACHINE_ESSENTIAL_EXTRA_RDEPENDS += "flatsat-bitstream flatsat2-overlays"
```

## linux/layers/meta-flatsat2-bsp/conf/machine/microzed.conf
```bitbake
MACHINEOVERRIDES =. "${@['', 'microzed:']['microzed' != '${MACHINE}']}"

require conf/machine/include/flatsat-common.inc

HDF_BASE = "file://"
HDF_PATH = "${FLATSAT_BSP_LAYERDIR}/hw/xsa/flatsat2.xsa"

PACKAGE_EXTRA_ARCHS:append = "${@['', ' microzed']['microzed' != '${MACHINE}']}"
```

## linux/layers/meta-flatsat2-bsp/conf/machine/zedboard.conf
```bitbake
MACHINEOVERRIDES =. "${@['', 'zedboard:']['zedboard' != '${MACHINE}']}"

require conf/machine/include/flatsat-common.inc

HDF_BASE = "file://"
HDF_PATH = "${FLATSAT_BSP_LAYERDIR}/hw/xsa/zed.xsa"

PACKAGE_EXTRA_ARCHS:append = "${@['', ' zedboard']['zedboard' != '${MACHINE}']}"
```

## linux/layers/meta-flatsat2/conf/distro/flatsat2.conf
```bitbake
require conf/distro/poky.conf

DISTRO          = "flatsat2"
DISTRO_NAME     = "FlatSat2"
DISTRO_VERSION  = "1.0-snapshot-${DATE}"
TARGET_VENDOR   = "-spacelab"
MAINTAINER      = "carlos.porto@spacelab.ufsc.br"
SDK_VENDOR      = "-spacelabsdk"
SDK_VERSION     = "${@d.getVar('DISTRO_VERSION').replace('snapshot-${DATE}', 'snapshot')}"

DISTRO_VERSION[vardepsexclude] = "DATE"

INIT_MANAGER = "systemd"
DISTRO_FEATURES:append = " systemd usrmerge"
DISTRO_FEATURES:remove = "sysvinit"
DISTRO_FEATURES_BACKFILL_CONSIDERED:append = " sysvinit"
DISTRO_FEATURES:append = " usbhost usbgadget ipv6 largefile"
DISTRO_FEATURES:remove = "3g x11 nfc wayland"

VIRTUAL-RUNTIME_syslog            ?= ""
VIRTUAL-RUNTIME_base-utils-syslog ?= ""

PACKAGE_CLASSES           = "package_ipk"

IMAGE_FSTYPES             ?= "tar.gz wic ext4"
IMAGE_ROOTFS_EXTRA_SPACE  ?= "524288"
IMAGE_LINK_NAME = "flatsat2"
IMAGE_NAME_SUFFIX = ""
EXTRA_IMAGE_FEATURES ?= " \
                          ssh-server-openssh \
                          package-management \
                          "

SDKMACHINE ?= "x86_64"
TOOLCHAIN_HOST_TASK:append   = " nativesdk-cmake nativesdk-pkgconfig"
TOOLCHAIN_TARGET_TASK:append = " packagegroup-core-standalone-sdk-target \
                                 packagegroup-core-sdk"

LICENSE_FLAGS_ACCEPTED:append = " xilinx"
```
